## boards/shields/hector36/Kconfig.defconfig
```kconfig
if SHIELD_HECTOR36_DONGLE || SHIELD_HECTOR36_DONGLE_DISPLAY || SHIELD_HECTOR36_LEFT_CENTRAL

config ZMK_SPLIT
    default y

config ZMK_SPLIT_ROLE_CENTRAL
    default y

config ZMK_USB
    default y

config ZMK_SPLIT_BLE_CENTRAL_BATTERY_LEVEL_FETCHING
    default y

config ZMK_STUDIO
    default y

endif


if SHIELD_HECTOR36_DONGLE || SHIELD_HECTOR36_DONGLE_DISPLAY

config ZMK_KEYBOARD_NAME
    default "hector36"

config ZMK_SPLIT_BLE_CENTRAL_PERIPHERALS
    default 2

config ZMK_SPLIT_BLE_CENTRAL_BATTERY_LEVEL_PROXY
    default y

config ZMK_SLEEP
    default n

endif


if SHIELD_HECTOR36_DONGLE

config BT_BAS
    default n

endif


if SHIELD_HECTOR36_LEFT_CENTRAL

config ZMK_KEYBOARD_NAME
    default "hector36"

config ZMK_SPLIT_BLE_CENTRAL_BATTERY_LEVEL_PROXY
    default y

endif


if SHIELD_HECTOR36_LEFT_PERIPHERAL || SHIELD_HECTOR36_RIGHT_PERIPHERAL

config ZMK_SPLIT
    default y

config ZMK_BATTERY
    default y

config ZMK_BATTERY_REPORTING
    default y

config BT_BAS
    default y

endif

config ZMK_BLE
    default y
```

## boards/shields/hector36/Kconfig.shield
```kconfig
config SHIELD_HECTOR36_DONGLE
	def_bool $(shields_list_contains,hector36_dongle)

config SHIELD_HECTOR36_DONGLE_DISPLAY
	def_bool $(shields_list_contains,hector36_dongle_display)

config SHIELD_HECTOR36_LEFT_CENTRAL
	def_bool $(shields_list_contains,hector36_left_central)

config SHIELD_HECTOR36_LEFT_PERIPHERAL
	def_bool $(shields_list_contains,hector36_left_peripheral)

config SHIELD_HECTOR36_RIGHT_PERIPHERAL
	def_bool $(shields_list_contains,hector36_right_peripheral)
```
